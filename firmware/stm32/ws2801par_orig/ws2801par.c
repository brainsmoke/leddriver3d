#include <stdlib.h>
#include <string.h>
#include "stm32f0xx.h"

#include "ws2801par.h"
#include "util.h"

typedef struct
{
	transposed_t transpose[N_VALUES_PER_STRIP];
	uint8_t low_bytes[N_VALUES];

} frame_t;

frame_t frame_a, frame_b;

uint8_t residual[N_VALUES];
frame_t * volatile cur;
frame_t * volatile next;

#define RECV_BUF_SZ (2048)
volatile uint8_t recv_buf[RECV_BUF_SZ];

/*
# emulate original single strip order expected by software
facet_order = [
    21,22, 1,19,15,16,17,18, 2, 6, 7, 8, 9, 5, 3,
    52,53,54,50,51, 4,12,13,14,10,11, 0,23,24,20,
    34,30,44,35,36,37,38,39,40,49,45,46,47,48,41,
    59,55,56,57,58,42,26,27,28,29,25,43,31,32,33
]

led_order = [ f*5+l for f in facet_order for l in range(5) ]

byte_order = [ l*3+c for l in led_order for c in (0,1,2) ]

n_strips = 12
n_bytes_per_strip = len(byte_order)//n_strips
n_values = n_strips*n_bytes_per_strip
assert len(byte_order) == n_values

*/
static const uint16_t low_byte_index[] = 
{
/*

# byte 0 strip 0, byte 0 strip 1, ...
scattered = [ None ] * n_values

for i in range(len(byte_order)):
    scattered[i] = (byte_order[i]%n_bytes_per_strip)*n_strips + byte_order[i]//n_bytes_per_strip

for line in range(0, n_values, 15):
    print("\t" + ''.join('{:4d},'.format(n) for n in scattered[line:line+15]))
*/
	 184, 196, 208, 220, 232, 244, 256, 268, 280, 292, 304, 316, 328, 340, 352,
	 364, 376, 388, 400, 412, 424, 436, 448, 460, 472, 484, 496, 508, 520, 532,
	 180, 192, 204, 216, 228, 240, 252, 264, 276, 288, 300, 312, 324, 336, 348,
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	 546, 558, 570, 582, 594, 606, 618, 630, 642, 654, 666, 678, 690, 702, 714,
};

static const uint8_t high_byte_index[] = 
{
/*
for line in range(0, n_values, 30):
    print("\t" + ''.join('{:2d},'.format(n//12) for n in scattered[line:line+30]))
*/
	15,16,17,18,19,20,21,22,23,24,25,26,27,28,29,30,31,32,33,34,35,36,37,38,39,40,41,42,43,44,
	15,16,17,18,19,20,21,22,23,24,25,26,27,28,29,60,61,62,63,64,65,66,67,68,69,70,71,72,73,74,
	 0, 1, 2, 3, 4, 5, 6, 7, 8, 9,10,11,12,13,14,15,16,17,18,19,20,21,22,23,24,25,26,27,28,29,
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	30,31,32,33,34,35,36,37,38,39,40,41,42,43,44,45,46,47,48,49,50,51,52,53,54,55,56,57,58,59,
};

#define P0 (1<<9)
#define P1 (1<<10)
#define P2 (1<<11)
#define P3 (1<<12)
#define P4 (1<<13)
#define P5 (1<<14)
#define P6 (1<<1)
#define P7 (1<<2)
#define P8 (1<<3)
#define P9 (1<<4)
#define PA (1<<5)
#define PB (1<<6)

static const uint16_t high_byte_pin[] =
{
/*
for line in range(0, n_values, 30):
    print("\t" + ''.join('P{:X},'.format(n%12) for n in scattered[line:line+30]))
*/
	P4,P4,P4,P4,P4,P4,P4,P4,P4,P4,P4,P4,P4,P4,P4,P4,P4,P4,P4,P4,P4,P4,P4,P4,P4,P4,P4,P4,P4,P4,
	P0,P0,P0,P0,P0,P0,P0,P0,P0,P0,P0,P0,P0,P0,P0,P3,P3,P3,P3,P3,P3,P3,P3,P3,P3,P3,P3,P3,P3,P3,
	P3,P3,P3,P3,P3,P3,P3,P3,P3,P3,P3,P3,P3,P3,P3,P3,P3,P3,P3,P3,P3,P3,P3,P3,P3,P3,P3,P3,P3,P3,
	P3,P3,P3,P3,P3,P3,P3,P3,P3,P3,P3,P3,P3,P3,P3,P3,P3,P3,P3,P3,P3,P3,P3,P3,P3,P3,P3,P3,P3,P3,
	P0,P0,P0,P0,P0,P0,P0,P0,P0,P0,P0,P0,P0,P0,P0,P1,P1,P1,P1,P1,P1,P1,P1,P1,P1,P1,P1,P1,P1,P1,
	P1,P1,P1,P1,P1,P1,P1,P1,P1,P1,P1,P1,P1,P1,P1,P1,P1,P1,P1,P1,P1,P1,P1,P1,P1,P1,P1,P1,P1,P1,
	P1,P1,P1,P1,P1,P1,P1,P1,P1,P1,P1,P1,P1,P1,P1,P1,P1,P1,P1,P1,P1,P1,P1,P1,P1,P1,P1,P1,P1,P1,
	P0,P0,P0,P0,P0,P0,P0,P0,P0,P0,P0,P0,P0,P0,P0,PA,PA,PA,PA,PA,PA,PA,PA,PA,PA,PA,PA,PA,PA,PA,
	PA,PA,PA,PA,PA,PA,PA,PA,PA,PA,PA,PA,PA,PA,PA,PA,PA,PA,PA,PA,PA,PA,PA,PA,PA,PA,PA,PA,PA,PA,
	PA,PA,PA,PA,PA,PA,PA,PA,PA,PA,PA,PA,PA,PA,PA,PA,PA,PA,PA,PA,PA,PA,PA,PA,PA,PA,PA,PA,PA,PA,
	P0,P0,P0,P0,P0,P0,P0,P0,P0,P0,P0,P0,P0,P0,P0,P2,P2,P2,P2,P2,P2,P2,P2,P2,P2,P2,P2,P2,P2,P2,
	P2,P2,P2,P2,P2,P2,P2,P2,P2,P2,P2,P2,P2,P2,P2,P2,P2,P2,P2,P2,P2,P2,P2,P2,P2,P2,P2,P2,P2,P2,
	P2,P2,P2,P2,P2,P2,P2,P2,P2,P2,P2,P2,P2,P2,P2,P2,P2,P2,P2,P2,P2,P2,P2,P2,P2,P2,P2,P2,P2,P2,
	P0,P0,P0,P0,P0,P0,P0,P0,P0,P0,P0,P0,P0,P0,P0,P4,P4,P4,P4,P4,P4,P4,P4,P4,P4,P4,P4,P4,P4,P4,
	P4,P4,P4,P4,P4,P4,P4,P4,P4,P4,P4,P4,P4,P4,P4,P4,P4,P4,P4,P4,P4,P4,P4,P4,P4,P4,P4,P4,P4,P4,
	P6,P6,P6,P6,P6,P6,P6,P6,P6,P6,P6,P6,P6,P6,P6,P6,P6,P6,P6,P6,P6,P6,P6,P6,P6,P6,P6,P6,P6,P6,
	P8,P8,P8,P8,P8,P8,P8,P8,P8,P8,P8,P8,P8,P8,P8,P7,P7,P7,P7,P7,P7,P7,P7,P7,P7,P7,P7,P7,P7,P7,
	P7,P7,P7,P7,P7,P7,P7,P7,P7,P7,P7,P7,P7,P7,P7,P7,P7,P7,P7,P7,P7,P7,P7,P7,P7,P7,P7,P7,P7,P7,
	P7,P7,P7,P7,P7,P7,P7,P7,P7,P7,P7,P7,P7,P7,P7,P7,P7,P7,P7,P7,P7,P7,P7,P7,P7,P7,P7,P7,P7,P7,
	P8,P8,P8,P8,P8,P8,P8,P8,P8,P8,P8,P8,P8,P8,P8,P9,P9,P9,P9,P9,P9,P9,P9,P9,P9,P9,P9,P9,P9,P9,
	P9,P9,P9,P9,P9,P9,P9,P9,P9,P9,P9,P9,P9,P9,P9,P9,P9,P9,P9,P9,P9,P9,P9,P9,P9,P9,P9,P9,P9,P9,
	P9,P9,P9,P9,P9,P9,P9,P9,P9,P9,P9,P9,P9,P9,P9,P9,P9,P9,P9,P9,P9,P9,P9,P9,P9,P9,P9,P9,P9,P9,
	P8,P8,P8,P8,P8,P8,P8,P8,P8,P8,P8,P8,P8,P8,P8,PB,PB,PB,PB,PB,PB,PB,PB,PB,PB,PB,PB,PB,PB,PB,
	PB,PB,PB,PB,PB,PB,PB,PB,PB,PB,PB,PB,PB,PB,PB,PB,PB,PB,PB,PB,PB,PB,PB,PB,PB,PB,PB,PB,PB,PB,
	PB,PB,PB,PB,PB,PB,PB,PB,PB,PB,PB,PB,PB,PB,PB,PB,PB,PB,PB,PB,PB,PB,PB,PB,PB,PB,PB,PB,PB,PB,
	P8,P8,P8,P8,P8,P8,P8,P8,P8,P8,P8,P8,P8,P8,P8,P5,P5,P5,P5,P5,P5,P5,P5,P5,P5,P5,P5,P5,P5,P5,
	P5,P5,P5,P5,P5,P5,P5,P5,P5,P5,P5,P5,P5,P5,P5,P5,P5,P5,P5,P5,P5,P5,P5,P5,P5,P5,P5,P5,P5,P5,
	P5,P5,P5,P5,P5,P5,P5,P5,P5,P5,P5,P5,P5,P5,P5,P5,P5,P5,P5,P5,P5,P5,P5,P5,P5,P5,P5,P5,P5,P5,
	P8,P8,P8,P8,P8,P8,P8,P8,P8,P8,P8,P8,P8,P8,P8,P6,P6,P6,P6,P6,P6,P6,P6,P6,P6,P6,P6,P6,P6,P6,
	P6,P6,P6,P6,P6,P6,P6,P6,P6,P6,P6,P6,P6,P6,P6,P6,P6,P6,P6,P6,P6,P6,P6,P6,P6,P6,P6,P6,P6,P6,
};

void SysTick_Handler(void)
{
	precomp_dithering(cur->transpose, cur->low_bytes, residual, N_VALUES_PER_STRIP);
	bitbang_ws2801(cur->transpose, N_VALUES_PER_STRIP, CLK_MASK, GPIOB);
}


static void init(void)
{
	int i;
	for (i=0; i<N_VALUES; i++)
		residual[i] = i*153;
	cur = &frame_a;
	next = &frame_b;

	clock48mhz();
	RCC->AHBENR |= RCC_AHBENR_GPIOAEN | RCC_AHBENR_GPIOBEN; 	// enable the clock to GPIOA
	GPIOA->ODR = 0;
	GPIOA->MODER = SWD;

	GPIOB->ODR = 0;
	GPIOB->MODER = O(0)|O(1)|O(2)|O(3)|O(4)|O(5)|O(6)|O(7)|O(8)|O(9)|O(10)|O(11)|O(12)|O(13)|O(14)|O(15);

	usart2_rx_pa3_dma5_enable(recv_buf, RECV_BUF_SZ, 48e6/2e6);
	enable_sys_tick(SYS_TICK_FRAMERATE);
}

static volatile uint8_t *recv_p=recv_buf, *recv_end=recv_buf;

static void dma_wait(void)
{
	if (recv_p == &recv_buf[RECV_BUF_SZ])
		recv_p = recv_end = &recv_buf[0];

	while(recv_p == recv_end)
	{
		recv_end = &recv_buf[RECV_BUF_SZ-DMA1_Channel5->CNDTR];
		if (recv_p > recv_end)
			recv_end = &recv_buf[RECV_BUF_SZ];
	}	
}

enum
{
	GOOD,
	GOOD_00,
	GOOD_01_FE,
	GOOD_FF,
	GOOD_FFFF,
	GOOD_FFFFFF,
	BAD,
	BAD_FF,
	BAD_FFFF,
	BAD_FFFFFF,

	STATE_COUNT,

	GOOD_RETURN,
	BAD_RETURN,
};

enum
{
	IN_00,
	IN_01_EF,
	IN_F0,
	IN_F1_FE,
	IN_FF,
};

static const uint8_t fsm[STATE_COUNT][8] =
{
	[GOOD]        = {  [IN_00] = GOOD_00, [IN_01_EF] = GOOD_01_FE, [IN_F0] = GOOD_01_FE , [IN_F1_FE] = GOOD_01_FE, [IN_FF] = GOOD_FF      , },
	[GOOD_00]     = {  [IN_00] = GOOD   , [IN_01_EF] = GOOD      , [IN_F0] = GOOD       , [IN_F1_FE] = GOOD      , [IN_FF] = GOOD         , },
	[GOOD_01_FE]  = {  [IN_00] = GOOD   , [IN_01_EF] = GOOD      , [IN_F0] = GOOD       , [IN_F1_FE] = GOOD      , [IN_FF] = BAD_FF       , },
	[GOOD_FF]     = {  [IN_00] = GOOD   , [IN_01_EF] = GOOD      , [IN_F0] = GOOD       , [IN_F1_FE] = GOOD      , [IN_FF] = GOOD_FFFF    , },
	[GOOD_FFFF]   = {  [IN_00] = BAD    , [IN_01_EF] = BAD       , [IN_F0] = BAD        , [IN_F1_FE] = BAD       , [IN_FF] = GOOD_FFFFFF  , },
	[GOOD_FFFFFF] = {  [IN_00] = BAD    , [IN_01_EF] = BAD       , [IN_F0] = GOOD_RETURN, [IN_F1_FE] = BAD       , [IN_FF] = BAD_FFFFFF   , },
	[BAD]         = {  [IN_00] = BAD    , [IN_01_EF] = BAD       , [IN_F0] = BAD        , [IN_F1_FE] = BAD       , [IN_FF] = BAD_FF       , },
	[BAD_FF]      = {  [IN_00] = BAD    , [IN_01_EF] = BAD       , [IN_F0] = BAD        , [IN_F1_FE] = BAD       , [IN_FF] = BAD_FFFF     , },
	[BAD_FFFF]    = {  [IN_00] = BAD    , [IN_01_EF] = BAD       , [IN_F0] = BAD        , [IN_F1_FE] = BAD       , [IN_FF] = BAD_FFFFFF   , },
	[BAD_FFFFFF]  = {  [IN_00] = BAD    , [IN_01_EF] = BAD       , [IN_F0] = BAD_RETURN , [IN_F1_FE] = BAD       , [IN_FF] = BAD_FFFFFF   , },

};

static int read_next_frame(void)
{
	int i, c;

	memset(next, 0, sizeof(frame_t));

	for(i=0; i<N_VALUES; i++)
	{
		if (recv_p == recv_end)
			dma_wait();

		c = *recv_p++;
		next->low_bytes[low_byte_index[i]] = c;

		if (recv_p == recv_end)
			dma_wait();

		c |= (*recv_p++)<<8;

		if (c > 0xff00)
			break;

		c >>= 8;

		transposed_t *t = &next->transpose[high_byte_index[i]];
		int pin = high_byte_pin[i];
		//write_value(t, pin, c); // faster, but there's plenty cycle budget
		if (c & 0x01)
			t->bit0 |= pin;
		if (c & 0x02)
			t->bit1 |= pin;
		if (c & 0x04)
			t->bit2 |= pin;
		if (c & 0x08)
			t->bit3 |= pin;
		if (c & 0x10)
			t->bit4 |= pin;
		if (c & 0x20)
			t->bit5 |= pin;
		if (c & 0x40)
			t->bit6 |= pin;
		if (c & 0x80)
			t->bit7 |= pin;
	}

	int s=GOOD;

	if (c == 0xffff)
		s = GOOD_FFFF;
	else if (c > 0xff00)
		s = BAD_FF;

	for(;;)
	{
		if (recv_p == recv_end)
			dma_wait();

		c = *recv_p++;

		if (c == 0)
			i = IN_00;
		else if (c < 0xf0)
			i = IN_01_EF;
		else if (c == 0xf0)
			i = IN_F0;
		else if (c == 0xff)
			i = IN_FF;
		else
			i = IN_F1_FE;

		s = fsm[s][i];

		if (s == GOOD_RETURN)
			return 1;
		else if (s == BAD_RETURN)
			return 0;
	}
}

int main(void)
{
	init();
	for(;;)
	{
		frame_t *tmp = cur;
		cur = next; /* swap is not atomic, but only the assignment of cur needs to be */
		next = tmp;
		while (! read_next_frame() );
	}
}

